## configs/cubieboard2_gui_defconfig
```kconfig
# Architecture
BR2_arm=y
BR2_cortex_a7=y

BR2_JLEVEL=4
BR2_ARM_EABIHF=y
BR2_OPTIMIZE_2=y
BR2_ARM_FPU_NEON_VFPV4=y

BR2_TOOLCHAIN_BUILDROOT_CXX=y
BR2_TOOLCHAIN_BUILDROOT_GLIBC=y
BR2_TOOLCHAIN_BUILDROOT_WCHAR=y
BR2_TOOLCHAIN_BUILDROOT_LOCALE=y
BR2_TOOLCHAIN_BUILDROOT_LARGEFILE=y
BR2_TOOLCHAIN_BUILDROOT_INET_IPV6=y
BR2_TOOLCHAIN_BUILDROOT_INET_RPC=y
BR2_TOOLCHAIN_BUILDROOT_VENDOR="cubieboard2"

BR2_PACKAGE_BUSYBOX_SHOW_OTHERS=y
#BR2_PACKAGE_BUSYBOX_CONFIG="package/busybox/sunxi-qt5.config"

BR2_PACKAGE_NANO=y
BR2_PACKAGE_BASH=y
BR2_PACKAGE_DHCP=y
BR2_PACKAGE_DHCP_CLIENT=y
BR2_PACKAGE_OPENSSH=y
BR2_ENABLE_LOCALE_PURGE=y
BR2_ENABLE_LOCALE_WHITELIST="C en_US"

BR2_PACKAGE_QT5=y
BR2_PACKAGE_QT5BASE=y
BR2_PACKAGE_QT5BASE_LICENSE_APPROVED=y
BR2_PACKAGE_QT5BASE_NETWORK=y
BR2_PACKAGE_QT5BASE_CONCURRENT=y
BR2_PACKAGE_QT5BASE_SQL=y
BR2_PACKAGE_QT5BASE_SQLITE_QT=y
BR2_PACKAGE_QT5BASE_XML=y
BR2_PACKAGE_QT5BASE_GUI=y
BR2_PACKAGE_QT5BASE_WIDGETS=y
BR2_PACKAGE_QT5BASE_ICU=y
BR2_PACKAGE_QT5BASE_EGLFS=y
BR2_PACKAGE_QT5BASE_JPEG=y
BR2_PACKAGE_QT5BASE_PNG=y
BR2_PACKAGE_QT5BASE_FONTCONFIG=y
BR2_PACKAGE_QT5BASE_GIF=y
BR2_PACKAGE_QT5BASE_HARFBUZZ=y
BR2_PACKAGE_QT5DECLARATIVE=y
BR2_PACKAGE_QT5XMLPATTERNS=y
BR2_PACKAGE_QT5QUICKCONTROLS=y
BR2_PACKAGE_QT5SERIALPORT=y
BR2_PACKAGE_QT5GRAPHICALEFFECTS=y
BR2_PACKAGE_QT5IMAGEFORMATS=y
BR2_PACKAGE_QT5MULTIMEDIA=y
BR2_PACKAGE_QT5SVG=y
BR2_PACKAGE_QT5CONNECTIVITY=y

# System configuration
BR2_TARGET_GENERIC_GETTY=y
BR2_TARGET_GENERIC_GETTY_PORT="ttyS0"
BR2_TARGET_GENERIC_ROOT_PASSWD="000000"
BR2_TARGET_GENERIC_HOSTNAME="Cubieboard2"
BR2_TARGET_GENERIC_ISSUE="Welcome to Cubieboard2"
BR2_TARGET_GENERIC_GETTY_BAUDRATE_115200=y
BR2_ROOTFS_POST_IMAGE_SCRIPT="board/cubietech/cubieboard/post-image.sh"
BR2_ROOTFS_POST_BUILD_SCRIPT="board/cubietech/cubieboard/post-build-gui.sh"

# Additional tools
BR2_PACKAGE_SUNXI_MALI=y
BR2_PACKAGE_HOST_SUNXI_TOOLS=y
BR2_PACKAGE_HOST_UBOOT_TOOLS=y
BR2_PACKAGE_SUNXI_TOOLS=y
BR2_PACKAGE_SUNXI_BOARDS=y
BR2_PACKAGE_SUNXI_BOARDS_FEX_FILE="a20/cubieboard2.fex"

# Kernel headers
BR2_KERNEL_HEADERS_3_4=y

# Kernel
BR2_LINUX_KERNEL=y
BR2_LINUX_KERNEL_CUSTOM_GIT=y
BR2_LINUX_KERNEL_CUSTOM_REPO_URL="https://github.com/linux-sunxi/linux-sunxi.git"
BR2_LINUX_KERNEL_CUSTOM_REPO_VERSION="5dda5145c877335e17bd9ca48954841acc0f785a"
BR2_LINUX_KERNEL_VERSION="sunxi-3.4"
BR2_LINUX_KERNEL_USE_CUSTOM_CONFIG=y
BR2_LINUX_KERNEL_CUSTOM_CONFIG_FILE="board/cubietech/cubieboard/linux-cubieboard2.config"

# Bootloaders
BR2_TARGET_UBOOT=y
BR2_TARGET_UBOOT_BOARDNAME="cubieboard2"
BR2_TARGET_UBOOT_CUSTOM_GIT=y
BR2_TARGET_UBOOT_VERSION="sunxi"
BR2_TARGET_UBOOT_CUSTOM_REPO_URL="https://github.com/linux-sunxi/u-boot-sunxi.git"
BR2_TARGET_UBOOT_CUSTOM_REPO_VERSION="b4bca5e0651b460a4511582f07a935cb48f74948"
BR2_TARGET_UBOOT_FORMAT_BIN=y
BR2_TARGET_UBOOT_SPL=y
BR2_TARGET_UBOOT_SPL_NAME="u-boot-sunxi-with-spl.bin"
```

## configs/raspberrypi_gui_defconfig
```kconfig
BR2_arm=y
BR2_arm1176jzf_s=y

BR2_JLEVEL=4
BR2_ARM_EABIHF=y
BR2_OPTIMIZE_2=y

BR2_TOOLCHAIN_BUILDROOT_CXX=y
BR2_TOOLCHAIN_BUILDROOT_UCLIBC=y
BR2_TOOLCHAIN_BUILDROOT_WCHAR=y
BR2_TOOLCHAIN_BUILDROOT_LOCALE=y
BR2_TOOLCHAIN_BUILDROOT_LARGEFILE=y
BR2_TOOLCHAIN_BUILDROOT_INET_IPV6=y
BR2_TOOLCHAIN_BUILDROOT_INET_RPC=y
BR2_TOOLCHAIN_BUILDROOT_VENDOR="raspberrypi"

BR2_ENABLE_LOCALE_PURGE=y
BR2_ENABLE_LOCALE_WHITELIST="C en_US"

BR2_TARGET_GENERIC_GETTY_PORT="ttyAMA0"
BR2_TARGET_GENERIC_HOSTNAME="RaspberryPi"
BR2_TARGET_GENERIC_ROOT_PASSWD="000000"
BR2_TARGET_GENERIC_GETTY_BAUDRATE_115200=y
BR2_TARGET_GENERIC_ISSUE="Welcome To Raspberry Pi"
BR2_TARGET_OPTIMIZATION="-pipe -mhard-float -mfloat-abi=hard -mfpu=vfp -mtune=arm1176jzf-s -march=armv6zk -fsigned-char"

BR2_PACKAGE_NANO=y
BR2_PACKAGE_BASH=y
BR2_PACKAGE_OPENSSH=y
BR2_PACKAGE_DHCP=y
BR2_PACKAGE_DHCP_CLIENT=y

BR2_PACKAGE_QT5=y
BR2_PACKAGE_QT5BASE=y
BR2_PACKAGE_QT5BASE_LICENSE_APPROVED=y
BR2_PACKAGE_QT5BASE_NETWORK=y
BR2_PACKAGE_QT5BASE_CONCURRENT=y
BR2_PACKAGE_QT5BASE_SQL=y
BR2_PACKAGE_QT5BASE_SQLITE_QT=y
BR2_PACKAGE_QT5BASE_XML=y
BR2_PACKAGE_QT5BASE_GUI=y
BR2_PACKAGE_QT5BASE_WIDGETS=y
BR2_PACKAGE_QT5BASE_ICU=y
BR2_PACKAGE_QT5BASE_EGLFS=y
BR2_PACKAGE_QT5BASE_JPEG=y
BR2_PACKAGE_QT5BASE_PNG=y
BR2_PACKAGE_QT5BASE_FONTCONFIG=y
BR2_PACKAGE_QT5BASE_GIF=y
BR2_PACKAGE_QT5BASE_HARFBUZZ=y
BR2_PACKAGE_QT5DECLARATIVE=y
BR2_PACKAGE_QT5XMLPATTERNS=y
BR2_PACKAGE_QT5QUICKCONTROLS=y
BR2_PACKAGE_QT5SERIALPORT=y
BR2_PACKAGE_QT5GRAPHICALEFFECTS=y
BR2_PACKAGE_QT5IMAGEFORMATS=y
BR2_PACKAGE_QT5MULTIMEDIA=y
BR2_PACKAGE_QT5SVG=y
BR2_PACKAGE_QT5SCRIPT=y
BR2_PACKAGE_QT5CONNECTIVITY=y

BR2_PACKAGE_LIBCOFI=y
BR2_PACKAGE_RPI_FIRMWARE=y
BR2_PACKAGE_RPI_USERLAND=y

BR2_ROOTFS_POST_BUILD_SCRIPT="board/raspberrypi/post-build-gui.sh"

# Lock to 3.12 headers as the RPi kernel is based off the 3.12 branch
BR2_KERNEL_HEADERS_VERSION=y
BR2_DEFAULT_KERNEL_VERSION="3.12.28"
BR2_PACKAGE_HOST_LINUX_HEADERS_CUSTOM_3_12=y

BR2_LINUX_KERNEL=y
BR2_LINUX_KERNEL_ZIMAGE=y
BR2_LINUX_KERNEL_CUSTOM_GIT=y
BR2_LINUX_KERNEL_USE_DEFCONFIG=y
BR2_LINUX_KERNEL_DEFCONFIG="bcmrpi_quick"
BR2_LINUX_KERNEL_CUSTOM_REPO_URL="git://github.com/raspberrypi/linux.git"
BR2_LINUX_KERNEL_CUSTOM_REPO_VERSION="c256eb9968c8997dce47350d2075e42f1b3991d3"
```

## configs/raspberrypi_no_gui_defconfig
```kconfig
BR2_arm=y
BR2_arm1176jzf_s=y

BR2_JLEVEL=4
BR2_ARM_EABIHF=y
BR2_OPTIMIZE_2=y

BR2_TOOLCHAIN_BUILDROOT_CXX=y
BR2_TOOLCHAIN_BUILDROOT_UCLIBC=y
BR2_TOOLCHAIN_BUILDROOT_WCHAR=y
BR2_TOOLCHAIN_BUILDROOT_LOCALE=y
BR2_TOOLCHAIN_BUILDROOT_LARGEFILE=y
BR2_TOOLCHAIN_BUILDROOT_INET_IPV6=y
BR2_TOOLCHAIN_BUILDROOT_INET_RPC=y
BR2_TOOLCHAIN_BUILDROOT_VENDOR="raspberrypi"

BR2_ENABLE_LOCALE_PURGE=y
BR2_ENABLE_LOCALE_WHITELIST="C en_US"

BR2_TARGET_GENERIC_GETTY_PORT="tty1"
BR2_TARGET_GENERIC_HOSTNAME="RaspberryPi"
BR2_TARGET_GENERIC_ROOT_PASSWD="000000"
BR2_TARGET_GENERIC_GETTY_BAUDRATE_115200=y
BR2_TARGET_GENERIC_ISSUE="Welcome To Raspberry Pi"
BR2_TARGET_OPTIMIZATION="-pipe -mhard-float -mfloat-abi=hard -mfpu=vfp -mtune=arm1176jzf-s -march=armv6zk -fsigned-char"

BR2_PACKAGE_NANO=y
BR2_PACKAGE_BASH=y
BR2_PACKAGE_OPENSSH=y
BR2_PACKAGE_DHCP=y
BR2_PACKAGE_DHCP_CLIENT=y

BR2_PACKAGE_RPI_FIRMWARE=y

BR2_ROOTFS_POST_BUILD_SCRIPT="board/raspberrypi/post-build-no-gui.sh"

# Lock to 3.12 headers as the RPi kernel is based off the 3.12 branch
BR2_KERNEL_HEADERS_VERSION=y
BR2_DEFAULT_KERNEL_VERSION="3.12.28"
BR2_PACKAGE_HOST_LINUX_HEADERS_CUSTOM_3_12=y

BR2_LINUX_KERNEL=y
BR2_LINUX_KERNEL_ZIMAGE=y
BR2_LINUX_KERNEL_CUSTOM_GIT=y
BR2_LINUX_KERNEL_USE_DEFCONFIG=y
BR2_LINUX_KERNEL_DEFCONFIG="bcmrpi_quick"
BR2_LINUX_KERNEL_CUSTOM_REPO_URL="git://github.com/raspberrypi/linux.git"
BR2_LINUX_KERNEL_CUSTOM_REPO_VERSION="c256eb9968c8997dce47350d2075e42f1b3991d3"
```

## package/libbcm2835/Config.in
```kconfig
config BR2_PACKAGE_LIBBCM2835
	bool "libbcm2835"
	depends on BR2_PACKAGE_RPI_FIRMWARE
	help
	  This is a C library for Raspberry Pi (RPi).
	  It provides access to GPIO and other IO functions on the Broadcom BCM 2835 chip.
	  Allowing access to the 26 pin ISE plug on the RPi board so you can control and interface with various external devices.

	  http://www.airspayce.com/mikem/bcm2835/index.html
```
